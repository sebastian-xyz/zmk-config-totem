## config/west.yml
```yaml
manifest:
  remotes:
    - name: zmkfirmware
      url-base: https://github.com/zmkfirmware
    - name: sebastian-xyz
      url-base: https://github.com/sebastian-xyz
  projects:
    - name: zmk
      remote: zmkfirmware
      revision: main
      import: app/west.yml
    - name: zmk-dongle-screen
      remote: sebastian-xyz
      revision: add-mod-icon-toggle
  self:
    path: config
```
